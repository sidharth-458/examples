/dts-v1/;
/plugin/;
/{	fragment@0 {
   		target-path = "/";
    		__overlay__ {
        		test_overlay_node {
            			compatible = "test,overlay";
            			status = "okay";
        		};
    		};
	};
};
