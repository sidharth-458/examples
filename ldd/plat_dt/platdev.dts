/dts-v1/;
/plugin/;

/{
	fragment@0{
		target-path = "/platdev-0";
		__overlay__ {
			status = "disabled";
		};
	};
	fragment@1{
		target-path = "/platdev-1";
		__overlay__ {
			bitsilica,parity = <5>;
			bitsilica,baud = <19200>;
		};
	};

};

